// This file is generated automatically
// Source files max timestamp 7.4.2018 14:05:53
// Generated at 7.4.2018 14:05:55

const PROGMEM uint8_t img_car[8][128] = {
  { 0xFF, 0xFF, 0xFF, 0xFF, 0xFF, 0xFF, 0xFF, 0xFF, 0xFF, 0xFF, 0xFF, 0xFF, 0xFF, 0xFF, 0xFF, 0xFF, 
    0xFF, 0xFF, 0xFF, 0xFF, 0xFF, 0xFF, 0xFF, 0xFF, 0xFF, 0xFF, 0xFF, 0xFF, 0xFF, 0xFF, 0xFF, 0xFF, 
    0xFF, 0xFF, 0xFF, 0xFF, 0xFF, 0xFF, 0xFF, 0xFF, 0xFF, 0xFF, 0xFF, 0xFF, 0xFF, 0xFF, 0xFF, 0xFF, 
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    0xFF, 0xFF, 0xFF, 0xFF, 0xFF, 0xFF, 0xFF, 0xFF, 0xFF, 0xFF, 0xFF, 0xFF, 0xFF, 0xFF, 0xFF, 0xFF }
}; // img_car

const PROGMEM uint8_t img_f1[8][128] = {
  { 0x88, 0x62, 0x18, 0xA2, 0x48, 0x22, 0x48, 0x92, 0x28, 0x82, 0x68, 0x12, 0x48, 0x22, 0x94, 0x48, 
    0xA2, 0x58, 0x02, 0xD8, 0x02, 0xD4, 0x0A, 0xA0, 0x5A, 0x80, 0x6A, 0x94, 0x2A, 0xD0, 0x4A, 0x14, 
    0xE2, 0x18, 0xC2, 0x2C, 0xD0, 0x0A, 0xA0, 0x56, 0x88, 0x22, 0xDC, 0x20, 0x8A, 0x74, 0x80, 0x3A, 
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    0x20, 0x80, 0x50, 0x20, 0x89, 0x14, 0xA9, 0x04, 0xB2, 0x45, 0x10, 0xAD, 0x00, 0x55, 0xAA, 0x00 }
}; // img_f1

const PROGMEM uint8_t img_moscow[8][128] = {
  { 0x00, 0x00, 0x20, 0x00, 0x00, 0x08, 0x40, 0x00, 0x00, 0x08, 0x40, 0x00, 0x00, 0x08, 0x80, 0x00, 
    0x08, 0x80, 0x00, 0x08, 0x80, 0x00, 0x08, 0x80, 0x00, 0x08, 0x80, 0x00, 0x08, 0x80, 0x00, 0x08, 
    0x40, 0x00, 0x08, 0x80, 0x00, 0x08, 0x40, 0x00, 0x08, 0x80, 0x00, 0x08, 0x40, 0x00, 0x08, 0x00, 
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    0x20, 0x04, 0x01, 0x23, 0x01, 0x07, 0x2A, 0x20, 0x6A, 0xA0, 0x28, 0x22, 0x00, 0x20, 0x01, 0x00 }
}; // img_moscow

const PROGMEM uint8_t img_planetearth[8][128] = {
  { 0x00, 0x00, 0x00, 0x00, 0x00, 0x00, 0x00, 0x00, 0x00, 0x00, 0x00, 0x00, 0x00, 0x00, 0x00, 0x00, 
    0x00, 0x00, 0x00, 0x00, 0x00, 0x00, 0x00, 0x00, 0x00, 0x00, 0x00, 0x00, 0x00, 0x00, 0x00, 0x00, 
    0x00, 0x00, 0x00, 0x00, 0x00, 0x00, 0x00, 0x00, 0x00, 0x00, 0x00, 0x00, 0x00, 0x00, 0x00, 0x00, 
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    0x00, 0x00, 0x00, 0x00, 0x00, 0x00, 0x00, 0x00, 0x00, 0x00, 0x00, 0x00, 0x00, 0x00, 0x00, 0x00 }
}; // img_planetearth

const PROGMEM uint8_t img_sputnik[8][128] = {
  { 0x00, 0x00, 0x01, 0x00, 0x00, 0x00, 0x01, 0x00, 0x00, 0x00, 0x01, 0x00, 0x00, 0x02, 0x00, 0x02, 
    0x00, 0x02, 0x00, 0x02, 0x00, 0x02, 0x00, 0x00, 0x02, 0x00, 0x02, 0x00, 0x02, 0x00, 0x02, 0x00, 
    0x02, 0x00, 0x00, 0x02, 0x00, 0x00, 0x02, 0x00, 0x00, 0x02, 0x00, 0x00, 0x02, 0x00, 0x00, 0x02, 
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    0x00, 0x00, 0x00, 0x00, 0x00, 0x00, 0x00, 0x00, 0x00, 0x00, 0x00, 0x00, 0x00, 0x00, 0x00, 0x00 }
}; // img_sputnik

const PROGMEM uint8_t img_supercar[8][128] = {
  { 0x00, 0x00, 0x00, 0x00, 0x00, 0x00, 0x00, 0x00, 0x00, 0x00, 0x00, 0x00, 0x00, 0x00, 0x00, 0x00, 
    0x00, 0x00, 0x00, 0x00, 0x00, 0x00, 0x00, 0x00, 0x00, 0x00, 0x00, 0x00, 0x00, 0x00, 0x00, 0x00, 
    0x00, 0x00, 0x00, 0x00, 0x00, 0x00, 0x00, 0x00, 0x00, 0x00, 0x00, 0x00, 0x00, 0x00, 0x00, 0x00, 
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    0x00, 0xD0, 0x00, 0x40, 0xA4, 0x08, 0x60, 0x8A, 0x20, 0xD5, 0x00, 0xA9, 0x40, 0x2A, 0x90, 0x44 }
}; // img_supercar

const PROGMEM uint8_t img_vader[8][128] = {
  { 0x00, 0x54, 0x02, 0x90, 0x22, 0x88, 0x22, 0x48, 0x12, 0x88, 0x22, 0x54, 0x82, 0x28, 0x42, 0x14, 
    0xAA, 0x00, 0x55, 0xA2, 0x08, 0xB6, 0x40, 0x95, 0x20, 0x4A, 0x50, 0x6B, 0x04, 0x72, 0x09, 0xD4, 
    0x22, 0x55, 0xAC, 0x42, 0x69, 0xA4, 0x6A, 0x95, 0x20, 0xDE, 0x21, 0x54, 0x8A, 0x55, 0xA0, 0x5A, 
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    0xFB, 0x4C, 0xB3, 0xDD, 0xAA, 0xF5, 0x1A, 0xED, 0xB3, 0x5C, 0xB3, 0x4D, 0xB6, 0x59, 0xD6, 0xD9 }
}; // img_vader

const PROGMEM PGM_VOID_P const list_img[] = {
     &img_car,  &img_f1,  &img_moscow,  &img_planetearth,  &img_sputnik,  &img_supercar,  &img_vader
  };

